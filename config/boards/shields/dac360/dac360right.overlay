#include "dac360.dtsi"

&default_transform {
    col-offset = <6>;
};

&kscan0 {
    col-gpios
        = <&gpio0 11 (GPIO_ACTIVE_HIGH | GPIO_PULL_DOWN)> // COL 1
        , <&gpio1 0 (GPIO_ACTIVE_HIGH | GPIO_PULL_DOWN)> // COL 2
        , <&gpio0 24 (GPIO_ACTIVE_HIGH | GPIO_PULL_DOWN)> // COL 3
        , <&gpio0 22 (GPIO_ACTIVE_HIGH | GPIO_PULL_DOWN)> // COL 4
        , <&gpio0 20 (GPIO_ACTIVE_HIGH | GPIO_PULL_DOWN)> // COL 5
        , <&gpio0 17 (GPIO_ACTIVE_HIGH | GPIO_PULL_DOWN)> // COL 6
        ;
};