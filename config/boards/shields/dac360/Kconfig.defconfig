## config/boards/shields/dac360/Kconfig.defconfig
```kconfig
if SHIELD_DAC360LEFT

config ZMK_KEYBOARD_NAME
    default "Cosmos"

config ZMK_SPLIT_ROLE_CENTRAL
    default y

endif

if SHIELD_DAC360LEFT || SHIELD_DAC360RIGHT

config ZMK_SPLIT
    default y

endif
```
